## conf/layer.conf
```bitbake
# We have a conf and classes directory, add to BBPATH
BBPATH .= ":${LAYERDIR}"

# We have recipes-* directories, add to BBFILES
BBFILES += "${LAYERDIR}/recipes-*/*/*.bb \
	${LAYERDIR}/recipes-*/*/*.bbappend"

BBFILE_COLLECTIONS += "neurio"
BBFILE_PATTERN_neurio = "^${LAYERDIR}/"
BBFILE_PRIORITY_neurio = "6"

# add desired packages
IMAGE_INSTALL_append = " example dropbear ntp protobuf python-pyserial nano python-xbee"
```
